## app_core/build/Kconfig/boards/Kconfig.nrf7002dk
```kconfig
# Load board Kconfig descriptions.
osource "/opt/nordic/ncs/v3.0.2/zephyr/boards/nordic/nrf7002dk/Kconfig.nrf7002dk"
```

## app_core/build/app_core/Kconfig/boards/Kconfig.defconfig
```kconfig
# Load Zephyr board defconfig descriptions.
osource "/opt/nordic/ncs/v3.0.2/zephyr/boards/nordic/nrf7002dk/Kconfig.defconfig"
```
