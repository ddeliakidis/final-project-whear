## CMakeLists.txt
```
cmake_minimum_required(VERSION 3.20.0)

find_package(Zephyr REQUIRED HINTS $ENV{ZEPHYR_BASE})
project(whear_app_core)

target_sources(app PRIVATE
    src/main.c
    src/ipc_app.c
    src/wifi_manager.c
    src/ws_client.c
)

target_include_directories(app PRIVATE
    ${CMAKE_CURRENT_SOURCE_DIR}/../shared
    ${CMAKE_CURRENT_SOURCE_DIR}/src
)
```

## prj.conf
```kconfig
# ── WiFi (nRF7002 via QSPI) ──────────────────────────────────────────
CONFIG_WIFI=y
CONFIG_WIFI_NRF70=y
CONFIG_WIFI_NM_WPA_SUPPLICANT=y
CONFIG_NET_L2_ETHERNET=y

CONFIG_WIFI_CREDENTIALS=y
CONFIG_WIFI_CREDENTIALS_STATIC=y
CONFIG_WIFI_CREDENTIALS_STATIC_SSID="AirPennNet-Device"
CONFIG_WIFI_CREDENTIALS_STATIC_PASSWORD="penn1740wifi"
CONFIG_WIFI_CREDENTIALS_STATIC_TYPE_PSK=y

# ── Networking stack ─────────────────────────────────────────────────
CONFIG_NETWORKING=y
CONFIG_NET_SOCKETS=y
CONFIG_NET_IPV4=y
CONFIG_NET_TCP=y
CONFIG_NET_UDP=y
CONFIG_NET_DHCPV4=y
CONFIG_DNS_RESOLVER=y
CONFIG_NET_CONFIG_SETTINGS=y
CONFIG_NET_CONFIG_INIT_TIMEOUT=0

# ── HTTP + WebSocket ─────────────────────────────────────────────────
CONFIG_HTTP_CLIENT=y
CONFIG_WEBSOCKET_CLIENT=y

# ── Network buffers ──────────────────────────────────────────────────
CONFIG_NET_PKT_RX_COUNT=16
CONFIG_NET_PKT_TX_COUNT=16
CONFIG_NRF70_RX_NUM_BUFS=16
CONFIG_NET_BUF_RX_COUNT=16
CONFIG_NET_BUF_TX_COUNT=32
CONFIG_NET_TC_TX_COUNT=1

# ── Heap / memory ────────────────────────────────────────────────────
CONFIG_HEAP_MEM_POOL_SIZE=37000
CONFIG_HEAP_MEM_POOL_IGNORE_MIN=y
CONFIG_NRF_WIFI_CTRL_HEAP_SIZE=20000
CONFIG_NRF_WIFI_DATA_HEAP_SIZE=40000

# ── Stack sizes ──────────────────────────────────────────────────────
CONFIG_MAIN_STACK_SIZE=5200
CONFIG_NET_TX_STACK_SIZE=4096
CONFIG_NET_RX_STACK_SIZE=4096
CONFIG_SYSTEM_WORKQUEUE_STACK_SIZE=2048

# ── Do NOT overwrite our baremetal network core ──────────────────────
CONFIG_NRF53_UPGRADE_NETWORK_CORE=n

# ── GPIO (for SPU configuration) ────────────────────────────────────
CONFIG_GPIO=y

# ── Logging ──────────────────────────────────────────────────────────
CONFIG_LOG=y
CONFIG_LOG_DEFAULT_LEVEL=3
CONFIG_NET_LOG=y

# ── Console ──────────────────────────────────────────────────────────
CONFIG_CONSOLE=y
CONFIG_UART_CONSOLE=y
CONFIG_SERIAL=y

# ── POSIX API (for socket functions) ─────────────────────────────────
CONFIG_POSIX_API=y
```

## boards/nrf7002dk_nrf5340_cpuapp.overlay
```dts
/* App core overlay for the Whear project.
 *
 * The RFID UART (P1.04/P1.05) is handled by the network core — the app
 * core does not need any additional UART configuration.
 *
 * Reserve the shared-memory region so Zephyr doesn't allocate over it.
 */

/ {
    reserved-memory {
        #address-cells = <1>;
        #size-cells = <1>;
        ranges;

        /* Last 1 KB of net core RAM — IPC mailbox shared with net core */
        ipc_shmem: memory@2100FC00 {
            reg = <0x2100FC00 0x400>;
        };
    };
};
```

## src/main.c
```c
/*
 * Whear — nRF5340 application core (Zephyr).
 *
 * 1. Configures SPU to grant network core access to RFID UART pins.
 * 2. Releases network core from forced-off (it runs baremetal RFID).
 * 3. Connects to WiFi via nRF7002.
 * 4. Opens a WebSocket connection.
 * 5. Forwards RFID tags received via IPC to the server.
 */

#include <zephyr/kernel.h>
#include <zephyr/logging/log.h>

#include "ipc_app.h"
#include "ipc_shared.h"
#include "wifi_manager.h"
#include "ws_client.h"

LOG_MODULE_REGISTER(main, LOG_LEVEL_INF);

/* ── WebSocket server configuration (change to your server) ───────────── */

#define WS_SERVER_ADDR  "192.168.1.100"
#define WS_SERVER_PORT  8080
#define WS_URL_PATH     "/"

/* ── SPU: grant GPIO pins to network core ─────────────────────────────── */

#define NRF_SPU_BASE  0x50003000UL

/* SPU GPIOPORT[port].PERM[pin]
 *   Port 0: offset 0x4C0 + pin * 4
 *   Port 1: offset 0x540 + pin * 4
 *   Write 0 = non-secure (net core can access) */
#define SPU_GPIO_PERM(port, pin) \
    (*(volatile uint32_t *)(NRF_SPU_BASE + 0x4C0 + (port) * 0x80 + (pin) * 4))

static void configure_spu_for_net_core(void)
{
    /* Grant P1.04 (RFID UART TX) and P1.05 (RFID UART RX) */
    SPU_GPIO_PERM(1, 4) = 0;
    SPU_GPIO_PERM(1, 5) = 0;

    /* Grant P0.28 (LED1) for status indication */
    SPU_GPIO_PERM(0, 28) = 0;

    LOG_INF("SPU: granted P1.04, P1.05, P0.28 to network core");
}

/* ── Release network core from forced-off ─────────────────────────────── */

#define RESET_NETWORK_FORCEOFF \
    (*(volatile uint32_t *)(0x50005000UL + 0x614))

static void release_network_core(void)
{
    RESET_NETWORK_FORCEOFF = 0;
    k_msleep(100);
    LOG_INF("Network core released");
}

/* ── Main ─────────────────────────────────────────────────────────────── */

int main(void)
{
    LOG_INF("=== Whear App Core (Zephyr) ===");

    /* Step 1: Grant network core access to GPIO pins */
    configure_spu_for_net_core();

    /* Step 2: Initialize IPC consumer */
    ipc_app_init();

    /* Step 3: Release network core (starts baremetal RFID scanning) */
    release_network_core();

    /* Wait for net core to initialize */
    LOG_INF("Waiting for network core mailbox...");
    while (IPC_MAILBOX->magic != IPC_MAILBOX_MAGIC) {
        k_msleep(10);
    }
    LOG_INF("Network core mailbox ready");

    /* Step 4: Connect to WiFi */
    int ret = wifi_connect();
    if (ret != 0) {
        LOG_ERR("WiFi setup failed — running without network");
        /* Continue anyway to show IPC is working */
    }

    /* Step 5: Connect WebSocket (only if WiFi is up) */
    if (wifi_is_connected()) {
        ret = ws_connect(WS_SERVER_ADDR, WS_SERVER_PORT, WS_URL_PATH);
        if (ret != 0) {
            LOG_ERR("WebSocket connection failed");
        }
    }

    /* Step 6: Main loop — forward tags from IPC to WebSocket */
    LOG_INF("Entering main loop — waiting for RFID tags...");

    while (1) {
        ipc_tag_entry_t tag;

        if (ipc_app_wait_tag(&tag, K_SECONDS(5)) == 0) {
            /* Log the tag */
            LOG_INF("Tag EPC (%u bytes): RSSI=%d dBm",
                    tag.epc_len, (int)tag.rssi);

            /* Send over WebSocket if connected */
            if (ws_is_connected()) {
                ret = ws_send_tag(&tag);
                if (ret < 0) {
                    LOG_WRN("Send failed, reconnecting...");
                    ws_disconnect();
                    k_msleep(1000);
                    ws_connect(WS_SERVER_ADDR, WS_SERVER_PORT, WS_URL_PATH);
                }
            }
        }

        /* Check WiFi health and reconnect if needed */
        if (!wifi_is_connected()) {
            LOG_WRN("WiFi lost, attempting reconnect...");
            wifi_connect();
            if (wifi_is_connected()) {
                ws_connect(WS_SERVER_ADDR, WS_SERVER_PORT, WS_URL_PATH);
            }
        }
    }

    return 0;
}
```

## src/ipc_app.c
```c
/*
 * IPC consumer — application core side (Zephyr).
 *
 * Receives RFID tag data from the network core via shared memory,
 * signaled by the nRF5340 IPC hardware peripheral.
 */

#include "ipc_app.h"
#include <zephyr/irq.h>
#include <zephyr/logging/log.h>

LOG_MODULE_REGISTER(ipc_app, LOG_LEVEL_INF);

/* ── nRF5340 IPC peripheral (app core, secure domain) ────────────────── */

#define NRF_IPC_APP_BASE  0x5002A000UL

#define IPC_EVENTS_RECEIVE(ch) \
    (*(volatile uint32_t *)(NRF_IPC_APP_BASE + 0x100 + (ch) * 4))
#define IPC_INTENSET \
    (*(volatile uint32_t *)(NRF_IPC_APP_BASE + 0x304))
#define IPC_RECEIVE_CNF(ch) \
    (*(volatile uint32_t *)(NRF_IPC_APP_BASE + 0x590 + (ch) * 4))

/* App core IPC IRQ number (nRF5340 PS table 4.2.4) */
#define APP_IPC_IRQn  42

static K_SEM_DEFINE(ipc_tag_sem, 0, 1);

static uint32_t local_read_idx;

/* ── IPC ISR ──────────────────────────────────────────────────────────── */

static void ipc_isr(const void *arg)
{
    ARG_UNUSED(arg);

    if (IPC_EVENTS_RECEIVE(IPC_CH_NET_TO_APP)) {
        IPC_EVENTS_RECEIVE(IPC_CH_NET_TO_APP) = 0;
        k_sem_give(&ipc_tag_sem);
    }
}

/* ── Public API ───────────────────────────────────────────────────────── */

void ipc_app_init(void)
{
    local_read_idx = 0;

    /* Map IPC channel 0 receive event to generate interrupt */
    IPC_RECEIVE_CNF(IPC_CH_NET_TO_APP) = (1UL << IPC_CH_NET_TO_APP);

    /* Enable interrupt for channel 0 */
    IPC_INTENSET = (1UL << IPC_CH_NET_TO_APP);

    /* Register ISR with Zephyr */
    IRQ_CONNECT(APP_IPC_IRQn, 2, ipc_isr, NULL, 0);
    irq_enable(APP_IPC_IRQn);

    LOG_INF("IPC consumer initialized (IRQ %d)", APP_IPC_IRQn);
}

int ipc_app_wait_tag(ipc_tag_entry_t *out, k_timeout_t timeout)
{
    ipc_mailbox_t *mb = IPC_MAILBOX;

    /* If there are already unread tags, return immediately */
    __asm volatile ("dmb" ::: "memory");
    if (local_read_idx != mb->write_idx) {
        goto read_tag;
    }

    /* Otherwise wait for IPC signal */
    if (k_sem_take(&ipc_tag_sem, timeout) != 0) {
        return -1;   /* timeout */
    }

read_tag:
    __asm volatile ("dmb" ::: "memory");
    if (local_read_idx == mb->write_idx) {
        return -1;   /* spurious wakeup */
    }

    uint32_t idx = local_read_idx % IPC_RING_SIZE;
    *out = mb->tags[idx];

    __asm volatile ("dmb" ::: "memory");
    local_read_idx++;
    mb->read_idx = local_read_idx;

    return 0;
}
```

## src/ipc_app.h
```c
#ifndef IPC_APP_H
#define IPC_APP_H

#include <zephyr/kernel.h>
#include "ipc_shared.h"

/* Initialize IPC consumer (registers ISR, enables interrupt) */
void ipc_app_init(void);

/* Block until a tag is available from the network core, or timeout.
 * Returns 0 on success, -1 on timeout. */
int ipc_app_wait_tag(ipc_tag_entry_t *out, k_timeout_t timeout);

#endif /* IPC_APP_H */
```

## src/wifi_manager.c
```c
/*
 * WiFi connection manager for nRF7002DK.
 *
 * Uses Zephyr net_mgmt API with static credentials from prj.conf.
 */

#include "wifi_manager.h"

#include <zephyr/kernel.h>
#include <zephyr/net/net_if.h>
#include <zephyr/net/wifi_mgmt.h>
#include <zephyr/net/net_event.h>
#include <zephyr/logging/log.h>

LOG_MODULE_REGISTER(wifi_mgr, LOG_LEVEL_INF);

static K_SEM_DEFINE(wifi_connected_sem, 0, 1);
static K_SEM_DEFINE(ipv4_obtained_sem, 0, 1);

static struct net_mgmt_event_callback wifi_mgmt_cb;
static struct net_mgmt_event_callback ipv4_mgmt_cb;

static volatile int wifi_connected;

/* ── Event handlers ───────────────────────────────────────────────────── */

static void wifi_event_handler(struct net_mgmt_event_callback *cb,
                               uint32_t mgmt_event,
                               struct net_if *iface)
{
    ARG_UNUSED(iface);

    if (mgmt_event == NET_EVENT_WIFI_CONNECT_RESULT) {
        const struct wifi_status *status =
            (const struct wifi_status *)cb->info;

        if (status->status == 0) {
            LOG_INF("WiFi connected");
            wifi_connected = 1;
            k_sem_give(&wifi_connected_sem);
        } else {
            LOG_ERR("WiFi connection failed: %d", status->status);
        }
    } else if (mgmt_event == NET_EVENT_WIFI_DISCONNECT_RESULT) {
        LOG_WRN("WiFi disconnected");
        wifi_connected = 0;
    }
}

static void ipv4_event_handler(struct net_mgmt_event_callback *cb,
                                uint32_t mgmt_event,
                                struct net_if *iface)
{
    ARG_UNUSED(cb);
    ARG_UNUSED(iface);

    if (mgmt_event == NET_EVENT_IPV4_ADDR_ADD) {
        LOG_INF("IPv4 address obtained");
        k_sem_give(&ipv4_obtained_sem);
    }
}

/* ── Public API ───────────────────────────────────────────────────────── */

int wifi_connect(void)
{
    struct net_if *iface = net_if_get_first_wifi();
    if (!iface) {
        LOG_ERR("No WiFi interface found");
        return -1;
    }

    /* Register event callbacks */
    net_mgmt_init_event_callback(&wifi_mgmt_cb, wifi_event_handler,
                                 NET_EVENT_WIFI_CONNECT_RESULT |
                                 NET_EVENT_WIFI_DISCONNECT_RESULT);
    net_mgmt_add_event_callback(&wifi_mgmt_cb);

    net_mgmt_init_event_callback(&ipv4_mgmt_cb, ipv4_event_handler,
                                 NET_EVENT_IPV4_ADDR_ADD);
    net_mgmt_add_event_callback(&ipv4_mgmt_cb);

    /* Connect using stored static credentials */
    LOG_INF("Connecting to WiFi...");
    int ret = net_mgmt(NET_REQUEST_WIFI_CONNECT_STORED, iface, NULL, 0);
    if (ret) {
        LOG_ERR("WiFi connect request failed: %d", ret);
        return ret;
    }

    /* Wait for connection (30s timeout) */
    if (k_sem_take(&wifi_connected_sem, K_SECONDS(30)) != 0) {
        LOG_ERR("WiFi connection timed out");
        return -1;
    }

    /* Wait for DHCP IP (15s timeout) */
    LOG_INF("Waiting for DHCP...");
    if (k_sem_take(&ipv4_obtained_sem, K_SECONDS(15)) != 0) {
        LOG_ERR("DHCP timed out");
        return -1;
    }

    LOG_INF("WiFi ready");
    return 0;
}

int wifi_is_connected(void)
{
    return wifi_connected;
}
```

## src/wifi_manager.h
```c
#ifndef WIFI_MANAGER_H
#define WIFI_MANAGER_H

/* Initialize WiFi subsystem and connect using static credentials.
 * Blocks until connected and IP address is obtained, or timeout.
 * Returns 0 on success, negative on failure. */
int wifi_connect(void);

/* Returns true if WiFi is connected and has an IP address. */
int wifi_is_connected(void);

#endif /* WIFI_MANAGER_H */
```

## src/ws_client.c
```c
/*
 * WebSocket client for sending RFID tag data to a server.
 */

#include "ws_client.h"

#include <zephyr/kernel.h>
#include <zephyr/net/socket.h>
#include <zephyr/net/websocket.h>
#include <zephyr/logging/log.h>
#include <stdio.h>
#include <string.h>

LOG_MODULE_REGISTER(ws_client, LOG_LEVEL_INF);

static int ws_sock = -1;
static int tcp_sock = -1;

static uint8_t temp_recv_buf[512];

/* ── Public API ───────────────────────────────────────────────────────── */

int ws_connect(const char *server_addr, uint16_t port, const char *url_path)
{
    struct sockaddr_in addr = {
        .sin_family = AF_INET,
        .sin_port = htons(port),
    };

    /* Resolve server address */
    if (zsock_inet_pton(AF_INET, server_addr, &addr.sin_addr) != 1) {
        LOG_ERR("Invalid server address: %s", server_addr);
        return -1;
    }

    /* Create TCP socket */
    tcp_sock = zsock_socket(AF_INET, SOCK_STREAM, IPPROTO_TCP);
    if (tcp_sock < 0) {
        LOG_ERR("Failed to create TCP socket: %d", errno);
        return -1;
    }

    /* Connect TCP */
    LOG_INF("Connecting to %s:%u ...", server_addr, port);
    int ret = zsock_connect(tcp_sock, (struct sockaddr *)&addr, sizeof(addr));
    if (ret < 0) {
        LOG_ERR("TCP connect failed: %d", errno);
        zsock_close(tcp_sock);
        tcp_sock = -1;
        return -1;
    }

    /* Upgrade to WebSocket */
    struct websocket_request ws_req = {
        .host = server_addr,
        .url = url_path,
        .tmp_buf = temp_recv_buf,
        .tmp_buf_len = sizeof(temp_recv_buf),
    };

    ws_sock = websocket_connect(tcp_sock, &ws_req, 5000, NULL);
    if (ws_sock < 0) {
        LOG_ERR("WebSocket handshake failed: %d", ws_sock);
        zsock_close(tcp_sock);
        tcp_sock = -1;
        return -1;
    }

    LOG_INF("WebSocket connected");
    return 0;
}

int ws_send_tag(const ipc_tag_entry_t *tag)
{
    if (ws_sock < 0) {
        return -1;
    }

    /* Format tag as JSON */
    char json[256];
    int pos = 0;

    pos += snprintf(json + pos, sizeof(json) - pos, "{\"epc\":\"");
    for (uint8_t i = 0; i < tag->epc_len && i < IPC_MAX_EPC_LEN; i++) {
        pos += snprintf(json + pos, sizeof(json) - pos, "%02X", tag->epc[i]);
    }
    pos += snprintf(json + pos, sizeof(json) - pos,
                    "\",\"rssi\":%d}", (int)tag->rssi);

    /* Send as text frame (timeout in ms, SYS_FOREVER_MS = block forever) */
    int ret = websocket_send_msg(ws_sock,
                                 json, pos,
                                 WEBSOCKET_OPCODE_DATA_TEXT,
                                 true,   /* masked */
                                 true,   /* final */
                                 5000);  /* 5s timeout in ms */
    if (ret < 0) {
        LOG_ERR("WebSocket send failed: %d", ret);
        return ret;
    }

    LOG_DBG("Sent: %s", json);
    return 0;
}

void ws_disconnect(void)
{
    if (ws_sock >= 0) {
        websocket_disconnect(ws_sock);
        ws_sock = -1;
    }
    if (tcp_sock >= 0) {
        zsock_close(tcp_sock);
        tcp_sock = -1;
    }
    LOG_INF("WebSocket disconnected");
}

int ws_is_connected(void)
{
    return (ws_sock >= 0) ? 1 : 0;
}
```

## src/ws_client.h
```c
#ifndef WS_CLIENT_H
#define WS_CLIENT_H

#include "ipc_shared.h"

/* Connect to the WebSocket server.
 * Returns 0 on success, negative on failure. */
int ws_connect(const char *server_addr, uint16_t port, const char *url_path);

/* Send an RFID tag as JSON over the WebSocket.
 * Returns 0 on success, negative on failure. */
int ws_send_tag(const ipc_tag_entry_t *tag);

/* Close the WebSocket connection. */
void ws_disconnect(void);

/* Returns true if WebSocket is connected. */
int ws_is_connected(void);

#endif /* WS_CLIENT_H */
```
